## arch/arm/mach-kirkwood/Kconfig
```kconfig
if ARCH_KIRKWOOD

menu "Marvell Kirkwood Implementations"

config MACH_DB88F6281_BP
	bool "Marvell DB-88F6281-BP Development Board"
	help
	  Say 'Y' here if you want your kernel to support the
	  Marvell DB-88F6281-BP Development Board.

config MACH_RD88F6192_NAS
	bool "Marvell RD-88F6192-NAS Reference Board"
	help
	  Say 'Y' here if you want your kernel to support the
	  Marvell RD-88F6192-NAS Reference Board.

config MACH_RD88F6281
	bool "Marvell RD-88F6281 Reference Board"
	help
	  Say 'Y' here if you want your kernel to support the
	  Marvell RD-88F6281 Reference Board.

config MACH_MV88F6281GTW_GE
	bool "Marvell 88F6281 GTW GE Board"
	help
	  Say 'Y' here if you want your kernel to support the
	  Marvell 88F6281 GTW GE Board.

config MACH_SHEEVAPLUG
	bool "Marvell SheevaPlug Reference Board"
	help
	  Say 'Y' here if you want your kernel to support the
	  Marvell SheevaPlug Reference Board.

config MACH_ESATA_SHEEVAPLUG
	bool "Marvell eSATA SheevaPlug Reference Board"
	help
	  Say 'Y' here if you want your kernel to support the
	  Marvell eSATA SheevaPlug Reference Board.

config MACH_GURUPLUG
	bool "Marvell GuruPlug Reference Board"
	help
	  Say 'Y' here if you want your kernel to support the
	  Marvell GuruPlug Reference Board.

config MACH_TS219
	bool "QNAP TS-119 and TS-219 Turbo NAS"
	help
	  Say 'Y' here if you want your kernel to support the
	  QNAP TS-119 and TS-219 Turbo NAS devices.

config MACH_TS41X
	bool "QNAP TS-410, TS-410U, TS-419P and TS-419U Turbo NAS"
	help
	  Say 'Y' here if you want your kernel to support the
	  QNAP TS-410, TS-410U, TS-419P and TS-419U Turbo NAS
	  devices.

config MACH_DOCKSTAR
	bool "Seagate FreeAgent DockStar"
	help
	  Say 'Y' here if you want your kernel to support the
	  Seagate FreeAgent DockStar.

config MACH_OPENRD
	bool

config MACH_OPENRD_BASE
	bool "Marvell OpenRD Base Board"
	select MACH_OPENRD
	help
	  Say 'Y' here if you want your kernel to support the
	  Marvell OpenRD Base Board.

config MACH_OPENRD_CLIENT
	bool "Marvell OpenRD Client Board"
	select MACH_OPENRD
	help
	  Say 'Y' here if you want your kernel to support the
	  Marvell OpenRD Client Board.

config MACH_OPENRD_ULTIMATE
	bool "Marvell OpenRD Ultimate Board"
	select MACH_OPENRD
	help
	  Say 'Y' here if you want your kernel to support the
	  Marvell OpenRD Ultimate Board.

config MACH_T5325
	bool "HP t5325 Thin Client"
	help
	  Say 'Y' here if you want your kernel to support the
	  HP t5325 Thin Client.

endmenu

endif
```

## drivers/staging/rt2860/Kconfig
```kconfig
config RT2860
	tristate "Ralink 2860/3090 wireless support"
	depends on PCI && X86 && WLAN
	select CRC_CCITT
	select FW_LOADER
	---help---
	  This is an experimental driver for the Ralink 2860 and 3090
	  wireless chips.
```

## drivers/staging/rt3090/Kconfig
```kconfig
config RT3090
	tristate "Ralink 3090 wireless support"
	depends on BROKEN
	depends on PCI && X86 && WLAN
	select CRC_CCITT
	select FW_LOADER
	---help---
	  This is an experimental driver for the Ralink 3090 wireless chip.
```

## drivers/staging/rtl8192su/Kconfig
```kconfig
config RTL8192SU
	tristate "RealTek RTL8192SU Wireless LAN NIC driver"
	depends on BROKEN
	depends on PCI && WLAN
	depends on WIRELESS_EXT
	default N
	---help---
```

## drivers/staging/vt6656/Kconfig
```kconfig
config VT6656
	tristate "VIA Technologies VT6656 support"
	depends on WIRELESS_EXT && USB
	select FW_LOADER
	---help---
	This is a vendor-written driver for VIA VT6656.
```
